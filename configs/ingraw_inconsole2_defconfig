## configs/ingraw_inconsole2_defconfig
```kconfig
BR2_arm=y
BR2_cortex_a7=y
BR2_ARM_FPU_VFPV4=y
BR2_TOOLCHAIN_EXTERNAL=y
BR2_TARGET_GENERIC_HOSTNAME="inconsole2"
BR2_TARGET_GENERIC_ISSUE="InConsole 2.0 Welcome"
BR2_ROOTFS_DEVICE_CREATION_DYNAMIC_MDEV=y
BR2_TARGET_GENERIC_PASSWD_SHA256=y
BR2_TARGET_GENERIC_PASSWD_METHOD="sha-256"
BR2_TARGET_ENABLE_ROOT_LOGIN=y
BR2_INIT_BUSYBOX=y
BR2_TARGET_GENERIC_ROOT_PASSWD="WISKYRISKY"
BR2_ROOTFS_OVERLAY="board/ingraw/inconsole2/rootfs"
BR2_ROOTFS_POST_BUILD_SCRIPT="board/ingraw/inconsole2/scripts/post-build.sh"
BR2_ROOTFS_POST_IMAGE_SCRIPT="support/scripts/genimage.sh"
BR2_ROOTFS_POST_SCRIPT_ARGS="-c board/ingraw/inconsole2/scripts/genimage_sdcard.cfg"
BR2_TARGET_ROOTFS_EXT2=y
BR2_ROOTFS_SKELETON_DEFAULT=y
BR2_TARGET_ROOTFS_EXT2_4=y
BR2_TARGET_GENERIC_GETTY=y
BR2_TARGET_GENERIC_GETTY_PORT="ttyS3"
# BR2_TARGET_GENERIC_GETTY_BAUDRATE_KEEP is not set
BR2_TARGET_GENERIC_GETTY_BAUDRATE_115200=y
BR2_TARGET_GENERIC_GETTY_TERM="vt100"
BR2_TARGET_GENERIC_GETTY_OPTIONS="-n -l /bin/sh -f root"


# Kernel configuration
BR2_LINUX_KERNEL=y
BR2_LINUX_KERNEL_LATEST_VERSION=y
BR2_LINUX_KERNEL_PATCH="board/ingraw/inconsole2/patches/linux/"
BR2_LINUX_KERNEL_USE_CUSTOM_CONFIG=y
BR2_LINUX_KERNEL_CUSTOM_CONFIG_FILE="board/ingraw/inconsole2/configs/linux_defconfig"
BR2_LINUX_KERNEL_CONFIG_FRAGMENT_FILES="board/ingraw/inconsole2/configs/linux_input_bridge.fragment"
BR2_LINUX_KERNEL_CUSTOM_LOGO_PATH="board/ingraw/inconsole2/assets/bootlogo-kernel.png"
BR2_LINUX_KERNEL_DTS_SUPPORT=y
BR2_LINUX_KERNEL_CUSTOM_DTS_PATH="board/ingraw/inconsole2/devicetree/linux/sun8i-t113.dtsi board/ingraw/inconsole2/devicetree/linux/sun8i-inconsole2.dts"

# U-Boot configuration
BR2_TARGET_UBOOT=y
BR2_TARGET_UBOOT_BUILD_SYSTEM_KCONFIG=y
BR2_TARGET_UBOOT_CUSTOM_GIT=y
BR2_TARGET_UBOOT_CUSTOM_REPO_URL="https://github.com/apritzel/u-boot"
BR2_TARGET_UBOOT_CUSTOM_REPO_VERSION="t113s-mq-r-WIP"
BR2_TARGET_UBOOT_USE_CUSTOM_CONFIG=y
BR2_TARGET_UBOOT_CUSTOM_CONFIG_FILE="board/ingraw/inconsole2/configs/uboot_defconfig"
BR2_TARGET_UBOOT_NEEDS_DTC=y
BR2_TARGET_UBOOT_NEEDS_PYLIBFDT=y
BR2_TARGET_UBOOT_SPL=y
BR2_TARGET_UBOOT_SPL_NAME="u-boot-sunxi-with-spl.bin"
BR2_TARGET_UBOOT_CUSTOM_DTS_PATH="board/ingraw/inconsole2/devicetree/uboot/sun8i-t113s.dtsi board/ingraw/inconsole2/devicetree/uboot/sunxi-d1-t113.dtsi board/ingraw/inconsole2/devicetree/uboot/sunxi-d1s-t113.dtsi board/ingraw/inconsole2/devicetree/uboot/sun8i-inconsole2.dts"

# Package configuration
BR2_PACKAGE_HOST_GENIMAGE=y
BR2_PACKAGE_HOST_MTOOLS=y
BR2_PACKAGE_HOST_PYTHON3=y
BR2_PACKAGE_HOST_UBOOT_TOOLS=y
#BR2_PACKAGE_E2FSPROGS=y
#BR2_PACKAGE_E2FSPROGS_RESIZE2FS=y
#BR2_PACKAGE_FB_TEST_APP=y
#BR2_PACKAGE_PSPLASH=y
#BR2_PACKAGE_DROPBEAR=y
#BR2_PACKAGE_IPERF3=y
#BR2_PACKAGE_NTP=y
BR2_PACKAGE_ALSA_LIB=y
BR2_PACKAGE_ALSA_UTILS=y
BR2_PACKAGE_ALSA_UTILS_ALSACTL=y
BR2_PACKAGE_ALSA_UTILS_ALSAMIXER=y
BR2_PACKAGE_ALSA_UTILS_AMIXER=y
BR2_PACKAGE_ALSA_UTILS_APLAY=y
BR2_PACKAGE_ALSA_UTILS_SPEAKER_TEST=y
BR2_PACKAGE_SDL=y
BR2_PACKAGE_SDL_FBCON=y
BR2_PACKAGE_SDL_IMAGE=y
BR2_PACKAGE_SDL_IMAGE_PNG=y
BR2_PACKAGE_SDL_TTF=y
BR2_PACKAGE_DEJAVU=y
BR2_PACKAGE_DEJAVU_SANS=y
#BR2_PACKAGE_HTOP=y
BR2_PACKAGE_EVTEST=y
BR2_PACKAGE_INCONSOLE_RUNTIME=y
BR2_PACKAGE_PRBOOM=y
BR2_PACKAGE_DOOM_WAD=y
```

## package/inconsole-runtime/Config.in
```kconfig
config BR2_PACKAGE_INCONSOLE_RUNTIME
	bool "inconsole-runtime"
	depends on BR2_INSTALL_LIBSTDCPP
	depends on BR2_PACKAGE_SDL
	depends on BR2_PACKAGE_SDL_FBCON
	select BR2_PACKAGE_FREETYPE
	select BR2_PACKAGE_LIBPNG
	select BR2_PACKAGE_DEJAVU
	help
	  GUI launcher and runtime shell for InConsole devices.
	  Runs as a kiosk interface on tty0 with scenes:
	  launcher, first-run wizard, settings and diagnostics.

comment "inconsole-runtime needs a toolchain w/ C++"
	depends on !BR2_INSTALL_LIBSTDCPP || \
		!BR2_PACKAGE_SDL || \
		!BR2_PACKAGE_SDL_FBCON
```
